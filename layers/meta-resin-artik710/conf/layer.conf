## layers/meta-resin-artik710/conf/layer.conf
```bitbake
BBPATH .= ":${LAYERDIR}"

BBFILES += "${LAYERDIR}/recipes-*/*/*.bb \
            ${LAYERDIR}/recipes-*/*/*.bbappend"

BBFILE_COLLECTIONS += "resin-artik710"
BBFILE_PATTERN_resin-artik710 := "^${LAYERDIR}/"
BBFILE_PRIORITY_resin-artik710 = "1337"
```
